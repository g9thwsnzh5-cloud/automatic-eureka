## firmware/main/Kconfig.projbuild
```kconfig
menu "FEM board"

config FEM_WIFI_SSID
    string "Wi-Fi SSID"
    default "myssid"

config FEM_WIFI_PASSWORD
    string "Wi-Fi password"
    default "mypassword"

config FEM_TX_POWER_QDBM
    int "ESP32 max TX power, units of 0.25 dBm (8..84)"
    range 8 84
    default 8
    help
        Value is quantized by hardware: 8 -> ~2 dBm, 28/32 -> ~7 dBm, 34 -> 8.5 dBm.
        Default 8 (~2 dBm) keeps the RFX2401C input well below its +5 dBm P1dB with
        the 0 ohm pad, so the PA stays linear and OFDM EVM is clean. The real value is
        logged at boot via esp_wifi_get_max_tx_power(). Raise only if you fit a 3-6 dB
        pad (R8/R9/R10) or accept degraded EVM. Remember the ~100 mW EIRP legal limit.

config FEM_USE_LR_MODE
    bool "Use 802.11 LR (long range) protocol"
    default n
    help
        Espressif proprietary PHY. Works only between ESP32 devices
        (both must enable it). Normal phones/routers will not see the network.

endmenu
```

## firmware/sdkconfig.defaults
```kconfig
CONFIG_IDF_TARGET="esp32"
CONFIG_ESPTOOLPY_FLASHSIZE_4MB=y
CONFIG_ESP_PHY_MAX_WIFI_TX_POWER=20
CONFIG_LOG_DEFAULT_LEVEL_INFO=y
```
